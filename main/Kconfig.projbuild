## main/Kconfig.projbuild
```kconfig
menu "sevetest30 Configuration"

config WIFI_SSID
    string "WiFi SSID"
	default ""
	help
		It's the name of WiFi which SEVETEST30 connects to.

config WIFI_PASSWORD
    string "WiFi Password"
	default ""
	help
        It's the password of WiFi which SEVETEST30 connects to.
        If the WIFI is Open WiFi, please left blank. 

# 时区设置
config LOCAL_TZ 
    string "the time zone of your area"
    default "CST-8"
    help
        the time zone of your area

# NTP时间服务器
config NTP_SERVER_0
    string "the first ntp server address"
    default "ntp.aliyun.com"
    help
        the first ntp server address

config NTP_SERVER_1
    string "the second ntp server address"
    default "time.cloudflare.com"
    help
        the second ntp server address

config NTP_SERVER_2
    string "the third ntp server address"
    default "time.google.com"
    help
        the third ntp server address

# DNS服务器
config DNS_SERVER
    string "the dns server address"
    default "223.5.5.5"
    help
        the dns server address

# 百度服务的API相关
config BAIDU_API_ACCESS_API_KEY
    string "Baidu API API Key"
    default ""
    help
        Baidu API API Key

config BAIDU_API_ACCESS_SECRET_KEY
    string "Baidu API Secret Key"
    default ""
    help
        Baidu API Secret Key



# GPT聊天服务的API相关
config GPT_CHAT_ACCESS_KEY
    string "GPT Chat access key"
    default ""
    help
        GPT Chat Access key



config IP138_IP_LOOKUP_TOKEN
    string "ip138 ip lookup access token"
    default ""
    help
        you could get a free token if you haven't had it , just click "https://user.ip138.com/ip/"

  config QWEATHER_API_HOST
    string "qweather server access host"
    default ""
    help
        you could get one if you haven't had it , just click "https://dev.qweather.com/"

config QWEATHER_API_JWT_PRIVATE_KEY_WITHOUT_HEADER_FOOTER
    string "qweather server access private key without header and footer"
    default ""
    help
        you need generate one and copy it without header and footer to this field.

config QWEATHER_API_JWT_CREDENTIAL_ID
    string "qweather server access credentialID"
    default ""
    help
        you could get a free one if you haven't had it , just click "https://dev.qweather.com/"

config QWEATHER_API_JWT_PROJECT_ID
    string "qweather server access projectID"
    default ""
    help
        you could get a free one if you haven't had it , just click "https://dev.qweather.com/"

config AMAP_API_KEY
    string "amap server access key"
    default ""
    help
        you could get a free one if you haven't had it , just click "https://lbs.amap.com/"



config HIGH_TEMP
    int "highest temperature"
    default 40
    help
        what's the highest temperature in your living place,may be 40 degrees Celsius,please enter degree centigrade.

config LOW_TEMP
    int "lowest temperature"
    default 12
    help
        what's the lowest temperature in your living place,may be 12 degrees Celsius,please enter degree centigrade.

config COMFORT_TEMP
    int "comfortable temperature"
    default 26
    help
        what's the comfortable temperature do you think,may be 26 degrees Celsius,please enter degree centigrade.

config PUBLIC_DIVISOR
    int "public divisor"
    default 20
    help
        A common divisor that wants the difference between temperature and the three thresholds to be partially and equally mapped to 0-1, 
        so that it should always be greater than the difference between temperature and any three thresholds to a reasonable extent

endmenu
```
